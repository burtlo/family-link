## client/device/main/Kconfig.projbuild
```kconfig
menu "Family Link product login"

config FAMILY_P1_BASE_URL
    string "P1 API base URL for desk/host tests"
    default "http://127.0.0.1:8777"

config FAMILY_DESK_TOKEN
    string "Desk bearer token (leave empty to read NVS stub family_link/desk_token)"
    default ""

config FAMILY_WIFI_SSID
    string "Desk Wi-Fi SSID (injected by make app KIT=<nickname>)"
    default ""

config FAMILY_WIFI_PASSWORD
    string "Desk Wi-Fi password"
    default ""

config FAMILY_DEVICE_MEM_DIAGNOSTIC
    bool "Log DMA largest free block around display init"
    default n
    help
        When enabled, app_main logs the largest internal DMA block before
        display init, then that block plus lv_mem_monitor after display init.
        Log only. There is no numeric boot assert and no CI gate.

config FAMILY_DEVICE_MUTE_TRACE
    bool "Verbose mute latch and display diagnostics (serial)"
    default n
    help
        Logs V2_MUTE_EDGE on every latch transition and V2_MUTE_TICK every
        2 s while the login backlight is marked dark. Filter serial on tag
        product_mute. Latch edges are also logged when this is off.

endmenu
```

## client/device/sdkconfig.defaults
```kconfig
CONFIG_IDF_TARGET="esp32s3"
CONFIG_SPIRAM=y
CONFIG_SPIRAM_MODE_OCT=y
CONFIG_SPIRAM_SPEED_80M=y
CONFIG_SPIRAM_BOOT_INIT=y
CONFIG_SPIRAM_USE_MALLOC=y
CONFIG_SPIRAM_TRY_ALLOCATE_WIFI_LWIP=y
CONFIG_SPIRAM_MALLOC_RESERVE_INTERNAL=65536
CONFIG_SPIRAM_ALLOW_BSS_SEG_EXTERNAL_MEMORY=y
CONFIG_ESP_WIFI_STATIC_RX_BUFFER_NUM=8
CONFIG_ESP_WIFI_DYNAMIC_RX_BUFFER_NUM=24
CONFIG_BSP_LCD_DRAW_BUF_HEIGHT=40
CONFIG_BSP_LCD_DRAW_BUF_DOUBLE=n
CONFIG_ESP_WIFI_ENABLED=y
CONFIG_ESP_WIFI_STA_DISCONNECTED_PM_ENABLE=n
CONFIG_ESP_MAIN_TASK_STACK_SIZE=16384
CONFIG_LV_MEM_SIZE=32768
CONFIG_LV_FONT_MONTSERRAT_16=y
CONFIG_LV_FONT_MONTSERRAT_32=y
CONFIG_ESPTOOLPY_FLASHSIZE_16MB=y
CONFIG_ESP_CONSOLE_USB_SERIAL_JTAG=y
CONFIG_ESP_CONSOLE_SECONDARY_NONE=y
CONFIG_PARTITION_TABLE_CUSTOM=y
CONFIG_PARTITION_TABLE_CUSTOM_FILENAME="partitions.csv"
```

## client/labs/lab-02-bounded-inbox/Kconfig.projbuild
```kconfig
source "../kconfig/lab_common.projbuild"

menu "LAB-02 Bounded Inbox"

    config LAB02_EAGER_BASELINE
        bool "Eager 16-card baseline (comparison build)"
        default n
        help
            Build the eager comparison path (all cards for 16-item fixture).
            Use a separate build directory (e.g. build/labs/lab-02-bounded-inbox-eager).

    choice LAB02_FIXTURE
        prompt "Embedded inbox fixture size"
        default LAB02_FIXTURE_16
        help
            Select which embedded inbox JSON to load at boot.

        config LAB02_FIXTURE_8
            bool "8 items"
        config LAB02_FIXTURE_16
            bool "16 items"
        config LAB02_FIXTURE_64
            bool "64 items"
        config LAB02_FIXTURE_256
            bool "256 items"
    endchoice

    config LAB02_SLOW_BIND_MS
        int "Injected slow bind delay (ms), 0 = off"
        default 0
        range 0 5000
        help
            Scenario S-delay: sleep on the UI thread before applying bind labels.
            Use a small value (e.g. 50) to verify gestures are not blocked by bind work.

    config LAB02_SERVER_URL
        string "Phase B paging server URL (unused in Phase A)"
        default ""
        depends on !LAB02_EAGER_BASELINE

endmenu
```

## client/labs/lab-02-bounded-inbox/components/lab02/Kconfig.projbuild
```kconfig
# Shared "Family Link device lab" menu: keep in sync with client/labs/kconfig/lab_common.projbuild

menu "Family Link device lab"

    config LAB_AUTO_HARNESS
        bool "Auto-scroll inbox after boot (scripted traversal)"
        default n
        help
            When enabled, the lab firmware auto-scrolls through the inbox after boot
            (implementation is per lab). You do not need to touch the screen during
            capture; wait for HARNESS_DONE on serial. Same option in every lab project.
            Host builds: make lab.<name>.scripted

endmenu

menu "LAB-02 Bounded Inbox"

    config LAB02_BUILD_ID
        string "Frozen LAB-02 run identity"
        default "unconfigured"

    config LAB02_SCENARIO
        string "Scripted experiment scenario"
        default "nominal"
        help
            Named host-driven experiment. S-push and S-rm-focus enable a bounded
            focus dwell after the second scripted step so a managed action can
            be observed through the next background refresh. Nominal keeps the
            existing traversal cadence.

    config LAB02_SCENARIO_DWELL_MS
        int "Mutation scenario focus dwell (ms)"
        default 6500
        range 1000 10000
        depends on LAB_AUTO_HARNESS
        help
            Bounded harness-task dwell for S-push and S-rm-focus only. This does
            not hold the LVGL lock or delay nominal traversal.

    config LAB02_EAGER_BASELINE
        bool "Eager 16-card baseline (comparison build)"
        default n
        help
            Build the eager comparison path (all cards for 16-item fixture).
            Use a separate build directory (e.g. build/labs/lab-02-bounded-inbox-eager).

    choice LAB02_FIXTURE
        prompt "Embedded inbox fixture size"
        default LAB02_FIXTURE_16
        help
            Select which embedded inbox JSON to load at boot.

        config LAB02_FIXTURE_8
            bool "8 items"
        config LAB02_FIXTURE_16
            bool "16 items"
        config LAB02_FIXTURE_64
            bool "64 items"
        config LAB02_FIXTURE_256
            bool "256 items"
    endchoice

    config LAB02_SLOW_BIND_MS
        int "Injected slow bind delay (ms), 0 = off"
        default 0
        range 0 5000
        help
            Scenario S-delay: defer label application with an LVGL timer without
            sleeping on the UI thread. Use a small value (e.g. 50) to verify
            gestures stay responsive and stale binds cannot appear.

    config LAB02_SERVER_URL
        string "Phase B paging server URL (fl.inbox-page/2)"
        default ""
        depends on !LAB02_EAGER_BASELINE
        help
            Example: http://192.168.1.42:8765
            When non-empty, firmware uses Wi-Fi and HTTP paging instead of embedded fixtures.

    config LAB02_WIFI_SSID
        string "Wi-Fi SSID (Phase B)"
        default ""
        depends on !LAB02_EAGER_BASELINE

    config LAB02_WIFI_PASSWORD
        string "Wi-Fi password (Phase B)"
        default ""
        depends on !LAB02_EAGER_BASELINE

endmenu
```

## client/labs/lab-02-bounded-inbox/sdkconfig.defaults
```kconfig
CONFIG_IDF_TARGET="esp32s3"
CONFIG_ESPTOOLPY_FLASHSIZE_16MB=y
CONFIG_ESPTOOLPY_HEADER_FLASHSIZE_UPDATE=y

CONFIG_SPIRAM=y
CONFIG_SPIRAM_MODE_OCT=y
CONFIG_SPIRAM_SPEED_80M=y
CONFIG_SPIRAM_BOOT_INIT=y
CONFIG_SPIRAM_USE_MALLOC=y

CONFIG_ESP_CONSOLE_USB_SERIAL_JTAG=y
CONFIG_ESP_CONSOLE_SECONDARY_NONE=y

CONFIG_PARTITION_TABLE_CUSTOM=y
CONFIG_PARTITION_TABLE_CUSTOM_FILENAME="partitions.csv"

CONFIG_PARTITION_TABLE_SINGLE_APP_LARGE=y

CONFIG_LV_FONT_MONTSERRAT_14=y
CONFIG_LV_FONT_MONTSERRAT_16=y
CONFIG_LV_FONT_MONTSERRAT_20=y
CONFIG_LV_FONT_MONTSERRAT_24=y

# Lab02 options (see Kconfig.projbuild)
CONFIG_LAB02_FIXTURE_16=y
```

## client/labs/lab-03-media-playback/main/Kconfig.projbuild
```kconfig
menu "LAB-03 media experiment"
config LAB03_SCRIPTED
    bool "Run fixed scenario sequence and ten-minute sustained loop"
    default n
config LAB03_SERVER_URL
    string "Fixture server address (private build input)"
    default "http://127.0.0.1:8766"
config LAB03_WIFI_SSID
    string "Wi-Fi SSID"
    default ""
config LAB03_WIFI_PASSWORD
    string "Wi-Fi password"
    default ""
config LAB03_BUILD_ID
    string "Compiled input fingerprint"
    default "standalone"
endmenu
```

## client/labs/lab-04-sketch-format/main/Kconfig.projbuild
```kconfig
menu "LAB-04 sketch format"

config LAB04_SCRIPTED
	bool "Run all format scenarios automatically"
	default n
	help
		Automatically run all three format variants, checkpoint observations, and decided fault scenarios.

config LAB04_BUILD_ID
	string "Firmware build identity"
	default "lab04-fw-v1-manual"

endmenu
```

## client/labs/lab-04-sketch-format/sdkconfig.defaults
```kconfig
CONFIG_IDF_TARGET="esp32s3"
CONFIG_ESPTOOLPY_FLASHSIZE_16MB=y
CONFIG_ESPTOOLPY_HEADER_FLASHSIZE_UPDATE=y
CONFIG_SPIRAM=y
CONFIG_SPIRAM_MODE_OCT=y
CONFIG_SPIRAM_SPEED_80M=y
CONFIG_SPIRAM_BOOT_INIT=y
CONFIG_SPIRAM_USE_MALLOC=y
CONFIG_ESP_CONSOLE_USB_SERIAL_JTAG=y
CONFIG_ESP_CONSOLE_SECONDARY_NONE=y
CONFIG_PARTITION_TABLE_CUSTOM=y
CONFIG_PARTITION_TABLE_CUSTOM_FILENAME="partitions.csv"
CONFIG_BSP_LCD_DRAW_BUF_HEIGHT=50
CONFIG_LAB04_SCRIPTED=n
CONFIG_LAB04_BUILD_ID="lab04-fw-v1-manual"
CONFIG_COMPILER_CXX_EXCEPTIONS=y
CONFIG_ESP_MAIN_TASK_STACK_SIZE=8192
```

## client/labs/lab-04-sketch-format/sdkconfig.defaults.scripted
```kconfig
CONFIG_LAB04_SCRIPTED=y
CONFIG_LAB04_BUILD_ID="lab04-fw-v1-scripted"
CONFIG_COMPILER_CXX_EXCEPTIONS=y
CONFIG_ESP_MAIN_TASK_STACK_SIZE=8192
```

## client/labs/lab-05-transition-proof/components/lab05_peak/Kconfig
```kconfig
menu "LAB-05 peak model"

config LAB05_PEAK
    bool "Compile the additive LAB-05 peak model"
    default n
    help
        Default off. The component CMakeLists adds lab05_peak_model.c only
        when this symbol is y. Kconfig depends-on does not keep the .c file
        out of the lifecycle link; the CMake source list does. Firmware
        variant sdkconfig files are not part of the model package.

config LAB05_PEAK_REPLACE
    bool "Select the peak replace control in firmware"
    depends on LAB05_PEAK
    default n
    help
        Reserved for the firmware package. The domain model implements both
        the persistent-root and replace controls without this symbol.

endmenu
```

## client/labs/lab-05-transition-proof/main/Kconfig.projbuild
```kconfig
menu "LAB-05 transition proof"

config LAB05_SCRIPTED
    bool "Run one automatic transition after boot"
    default n

config LAB05_BUILD_ID
    string "Build identifier"
    default "lab05-manual-v1"

endmenu
```

## client/labs/lab-05-transition-proof/sdkconfig.defaults
```kconfig
CONFIG_IDF_TARGET="esp32s3"
CONFIG_ESPTOOLPY_FLASHSIZE_16MB=y
CONFIG_ESPTOOLPY_HEADER_FLASHSIZE_UPDATE=y
CONFIG_PARTITION_TABLE_SINGLE_APP_LARGE=y
CONFIG_ESP_CONSOLE_USB_SERIAL_JTAG=y
CONFIG_ESP_CONSOLE_SECONDARY_NONE=y
CONFIG_LAB05_BUILD_ID="lab05-manual-v1"
```

## client/labs/lab-06-stage-shell/main/Kconfig.projbuild
```kconfig
menu "LAB-06 stage shell"
    config LAB06_SCRIPTED
        bool "Run scripted stage lifecycle"
        default n

    config LAB06_BUILD_ID
        string "LAB-06 firmware build identity"
        default "lab06-fw-unconfigured"
endmenu
```

## client/labs/lab-06-stage-shell/sdkconfig.defaults
```kconfig
CONFIG_LV_MEM_SIZE=65536
CONFIG_IDF_TARGET="esp32s3"
CONFIG_LV_FONT_MONTSERRAT_16=y
```

## client/labs/lab-07-readiness-roster/main/Kconfig.projbuild
```kconfig
menu "LAB-07 readiness roster"

config LAB07_SCRIPTED
    bool "Run decided readiness scenarios automatically"
    default n
    help
        Run the decided roster, health, mute, and timeout scenarios without taps.
        The 10-minute idle and 5-minute cadence stay on the virtual clock.

config LAB07_BUILD_ID
    string "Firmware build identity"
    default "lab07-fw-v1-manual"

config LAB07_HEALTH_URL
    string "Synthetic health URL"
    default "http://127.0.0.1:8767/health"

config LAB07_ROSTER_URL
    string "Synthetic roster URL"
    default "http://127.0.0.1:8767/roster?script=eight"

config LAB07_HOLD_URL
    string "Synthetic held-response URL"
    default "http://127.0.0.1:8767/roster?script=delayed"

endmenu
```

## client/labs/lab-07-readiness-roster/sdkconfig.defaults.scripted
```kconfig
CONFIG_LAB07_SCRIPTED=y
CONFIG_LAB07_BUILD_ID="lab07-fw-v1-scripted"
CONFIG_LV_MEM_SIZE=65536
CONFIG_ESP_MAIN_TASK_STACK_SIZE=12288
```
