## client/labs/lab-08-pin-cooldown/main/Kconfig.projbuild
```kconfig
menu "LAB-08 PIN cooldown"

config LAB08_SCRIPTED
    bool "Run decided PIN scenarios automatically"
    default n
    help
        Run the decided PIN scenarios without taps.
        The retry delays, wrong-PIN copy, cooldown, and partial-entry return stay on the virtual clock.

config LAB08_BUILD_ID
    string "Firmware build identity"
    default "lab08-fw-v1-manual"

config LAB08_PIN_URL
    string "Synthetic PIN URL"
    default "http://127.0.0.1:8768/pin"

config LAB08_OBSERVE_URL
    string "Synthetic observation URL"
    default "http://127.0.0.1:8768/observe"

config LAB08_MALFORMED_URL
    string "Synthetic malformed URL"
    default "http://127.0.0.1:8768/malformed"

config LAB08_WIFI_SSID
    string "Desk Wi-Fi SSID for a kit build"
    default ""

config LAB08_WIFI_PASSWORD
    string "Desk Wi-Fi password for a kit build"
    default ""

endmenu
```

## client/labs/lab-08-pin-cooldown/sdkconfig.defaults
```kconfig
CONFIG_IDF_TARGET="esp32s3"
CONFIG_ESPTOOLPY_FLASHSIZE_16MB=y
CONFIG_ESPTOOLPY_HEADER_FLASHSIZE_UPDATE=y
CONFIG_SPIRAM=y
CONFIG_SPIRAM_MODE_OCT=y
CONFIG_SPIRAM_SPEED_80M=y
CONFIG_SPIRAM_BOOT_INIT=y
CONFIG_SPIRAM_USE_MALLOC=y
CONFIG_ESP_CONSOLE_USB_SERIAL_JTAG=y
CONFIG_ESP_CONSOLE_SECONDARY_NONE=y
CONFIG_PARTITION_TABLE_CUSTOM=y
CONFIG_PARTITION_TABLE_CUSTOM_FILENAME="partitions.csv"
CONFIG_BSP_LCD_DRAW_BUF_HEIGHT=50
CONFIG_LV_FONT_MONTSERRAT_14=y
CONFIG_LV_FONT_MONTSERRAT_16=y
CONFIG_LV_MEM_SIZE=65536
CONFIG_LAB08_BUILD_ID="lab08-fw-v1-manual"
CONFIG_ESP_MAIN_TASK_STACK_SIZE=16384
```

## client/labs/lab-08-pin-cooldown/sdkconfig.defaults.scripted
```kconfig
CONFIG_LAB08_SCRIPTED=y
CONFIG_LAB08_BUILD_ID="lab08-fw-v1-scripted"
CONFIG_LV_MEM_SIZE=65536
CONFIG_ESP_MAIN_TASK_STACK_SIZE=16384
```

## client/labs/lab-09-session-isolation/main/Kconfig.projbuild
```kconfig
menu "LAB-09 session isolation"

config LAB09_SCRIPTED
    bool "Run decided session scenarios automatically"
    default n
    help
        Run the decided signed-in scenarios without taps.

config LAB09_BUILD_ID
    string "Firmware build identity"
    default "lab09-fw-v1-manual"

config LAB09_BASE_URL
    string "Synthetic fixture base URL"
    default "http://127.0.0.1:8769"

config LAB09_WIFI_SSID
    string "Desk Wi-Fi SSID for a kit build"
    default ""

config LAB09_WIFI_PASSWORD
    string "Desk Wi-Fi password for a kit build"
    default ""

endmenu
```

## client/labs/lab-09-session-isolation/sdkconfig.defaults.scripted
```kconfig
CONFIG_LAB09_SCRIPTED=y
CONFIG_LAB09_BUILD_ID="lab09-fw-v1-scripted"
CONFIG_LV_MEM_SIZE=65536
CONFIG_ESP_MAIN_TASK_STACK_SIZE=16384
```

## client/labs/lab-10-record-canvas/main/Kconfig.projbuild
```kconfig
menu "LAB-10 record canvas"

config LAB10_SCRIPTED
    bool "Enable deterministic UI smoke harness"
    default n
    help
        Enables the package-local UI transition smoke path. It does not add
        capture, storage, audio, send, or networking behavior.

config LAB10_BUILD_ID
    string "LAB-10 firmware build identifier"
    default "lab10-render-l10-04-segment-default"

choice LAB10_RENDER_MODE
    prompt "LAB-10 render mode"
    default LAB10_RENDER_MODE_SEGMENT
    help
        Select the bounded renderer used by the ESP-IDF UI bridge. Segment
        mode is the normal pen-like device default. Direct point remains
        available for explicitly labeled control runs. All modes retain the
        same explicit per-update budgets.

config LAB10_RENDER_MODE_DIRECT_POINT
    bool "Direct point control (labeled control runs)"

config LAB10_RENDER_MODE_SEGMENT
    bool "Connected same-stroke segments (device default)"

config LAB10_RENDER_MODE_BOUNDED_BATCH
    bool "Bounded batch candidate"

config LAB10_RENDER_MODE_WHOLE_FRAME
    bool "Whole frame candidate"
endchoice

config LAB10_RENDER_MAX_POINTS_PER_UPDATE
    int "Maximum source points per render update"
    range 1 64
    default 8

config LAB10_RENDER_MAX_RASTER_OPS_PER_UPDATE
    int "Maximum logical raster operations per render update"
    range 1 512
    default 32

config LAB10_RENDER_MAX_PUBLICATION_OPS_PER_UPDATE
    int "Maximum logical publication operations per render update"
    range 1 512
    default 32

endmenu
```

## client/labs/lab-11-send-receipt/main/Kconfig.projbuild
```kconfig
menu "LAB-11 send receipt"

    config LAB11_SCRIPTED
        bool "Run the scripted send harness"
        default n

    config LAB11_BUILD_ID
        string "LAB-11 firmware build identity"
        default "lab11-fw-manual-v1"

    config LAB11_SERVER_HOST
        string "LAB-11 fixture host"
        default "127.0.0.1"

    config LAB11_SERVER_PORT
        int "LAB-11 fixture port"
        default 8770

    config LAB11_WIFI_SSID
        string "LAB-11 station SSID"
        default ""

    config LAB11_WIFI_PASSWORD
        string "LAB-11 station password"
        default ""

endmenu
```

## client/labs/lab-11-send-receipt/sdkconfig.defaults
```kconfig
CONFIG_IDF_TARGET="esp32s3"
CONFIG_ESPTOOLPY_FLASHSIZE_16MB=y
CONFIG_ESPTOOLPY_HEADER_FLASHSIZE_UPDATE=y
CONFIG_SPIRAM=y
CONFIG_SPIRAM_MODE_OCT=y
CONFIG_SPIRAM_SPEED_80M=y
CONFIG_SPIRAM_BOOT_INIT=y
CONFIG_SPIRAM_USE_MALLOC=y
CONFIG_ESP_CONSOLE_USB_SERIAL_JTAG=y
CONFIG_ESP_CONSOLE_SECONDARY_NONE=y
CONFIG_PARTITION_TABLE_CUSTOM=y
CONFIG_PARTITION_TABLE_CUSTOM_FILENAME="partitions.csv"
CONFIG_BSP_LCD_DRAW_BUF_HEIGHT=50
CONFIG_LV_FONT_DEFAULT_MONTSERRAT_16=y
CONFIG_LV_MEM_SIZE=65536
CONFIG_ESP_MAIN_TASK_STACK_SIZE=12288
CONFIG_LAB11_BUILD_ID="lab11-fw-manual-v1"
CONFIG_LAB11_SERVER_HOST="127.0.0.1"
CONFIG_LAB11_SERVER_PORT=8770
```

## client/labs/lab-12-profile-settings/main/Kconfig.projbuild
```kconfig
menu "LAB-12 profile/settings"
config LAB12_SCRIPTED
    bool "Run LAB-12 scripted harness"
    default n
config LAB12_PHASE_SHARED
    bool "Use shared-profile phase"
    default n
config LAB12_BUILD_ID
    string "LAB-12 firmware build identity"
    default "lab12-fw-manual-v1"
config LAB12_WIFI_SSID
    string "Fixture Wi-Fi SSID"
    default ""
config LAB12_WIFI_PASSWORD
    string "Fixture Wi-Fi password"
    default ""
config LAB12_SERVER_URL
    string "LAB-12 fixture service URL"
    default "http://127.0.0.1:8771"
endmenu
```

## client/labs/lab-12-profile-settings/sdkconfig.defaults
```kconfig
CONFIG_IDF_TARGET="esp32s3"
CONFIG_LV_FONT_MONTSERRAT_16=y
CONFIG_LV_FONT_MONTSERRAT_24=y
CONFIG_LV_FONT_MONTSERRAT_32=y
CONFIG_LAB12_BUILD_ID="lab12-fw-manual-v1"
CONFIG_LAB12_SERVER_URL="http://127.0.0.1:8771"
CONFIG_PARTITION_TABLE_CUSTOM=y
CONFIG_PARTITION_TABLE_CUSTOM_FILENAME="partitions.csv"
```

## client/labs/lab-14-device-ui-catalog/main/Kconfig.projbuild
```kconfig
menu "LAB-14 device UI catalog"

    config LAB14_SCRIPTED
        bool "Walk every packed scene after boot"
        default n

    config LAB14_BUILD_ID
        string "LAB-14 firmware build identity"
        default "lab14-fw-manual-v1"

endmenu
```

## client/labs/lab-15-capture-memory-envelope/main/Kconfig.projbuild
```kconfig
menu "LAB-15 capture memory envelope"

config LAB15_SCRIPTED
    bool "Enable scripted memory harness (fake clock)"
    default n

config LAB15_BUILD_ID
    string "LAB-15 firmware build identifier"
    default "lab15-fw-manual-v1"

config LAB15_PEAK_ALLOC_ONLY
    bool "Peak allocation only (no clock advance to duration cap)"
    depends on LAB15_SCRIPTED
    default n

choice LAB15_UI_MODE
    prompt "UI load arm"
    default LAB15_UI_NONE

config LAB15_UI_NONE
    bool "Capture-only baseline (no catalog montage)"

config LAB15_UI_CATALOG
    bool "Catalog montage (lab15-montage-v1)"
endchoice

choice LAB15_AUDIO_MODE
    prompt "Audio retention arm"
    default LAB15_AUDIO_PCM_RING

config LAB15_AUDIO_PCM_RING
    bool "Single PCM ring (5,760,000 bytes max)"

config LAB15_AUDIO_PCM_CHUNK
    bool "PCM chunks (fragmentation probe)"
endchoice

config LAB15_PCM_RING_BYTES
    int "PCM ring reservation bytes"
    depends on LAB15_AUDIO_PCM_RING
    default 5760000

config LAB15_PCM_CHUNK_COUNT
    int "PCM chunk count"
    depends on LAB15_AUDIO_PCM_CHUNK
    default 8

config LAB15_PCM_CHUNK_BYTES
    int "Bytes per PCM chunk"
    depends on LAB15_AUDIO_PCM_CHUNK
    default 720000

config LAB15_OPUS_LINK
    bool "Link Opus encoder stub (exploratory flash budget)"
    default n

config LAB15_SDMMC_SPILL
    bool "SDMMC spill stub (exploratory)"
    default n

endmenu
```

## client/labs/lab-15-capture-memory-envelope/sdkconfig.defaults
```kconfig
CONFIG_IDF_TARGET="esp32s3"
CONFIG_ESPTOOLPY_FLASHSIZE_16MB=y
CONFIG_ESPTOOLPY_HEADER_FLASHSIZE_UPDATE=y

CONFIG_SPIRAM=y
CONFIG_SPIRAM_MODE_OCT=y
CONFIG_SPIRAM_SPEED_80M=y
CONFIG_SPIRAM_BOOT_INIT=y
CONFIG_SPIRAM_USE_MALLOC=y

CONFIG_ESP_CONSOLE_USB_SERIAL_JTAG=y
CONFIG_ESP_CONSOLE_SECONDARY_NONE=y

CONFIG_PARTITION_TABLE_CUSTOM=y
CONFIG_PARTITION_TABLE_CUSTOM_FILENAME="partitions.csv"

CONFIG_LV_FONT_MONTSERRAT_14=y
CONFIG_LV_FONT_MONTSERRAT_16=y
CONFIG_LV_FONT_MONTSERRAT_32=y
CONFIG_LV_MEM_SIZE=65536

CONFIG_BSP_LCD_DRAW_BUF_HEIGHT=50

CONFIG_LAB15_SCRIPTED=n
CONFIG_LAB15_BUILD_ID="lab15-fw-manual-v1"
CONFIG_LAB15_UI_NONE=y
CONFIG_LAB15_AUDIO_PCM_RING=y
CONFIG_LAB15_PCM_RING_BYTES=5760000
CONFIG_LAB15_PEAK_ALLOC_ONLY=n
```

## client/labs/lab-15-capture-memory-envelope/sdkconfig.defaults.scripted
```kconfig
CONFIG_LAB15_SCRIPTED=y
CONFIG_LAB15_BUILD_ID="lab15-fw-scripted-v1"
CONFIG_LAB15_UI_CATALOG=y
CONFIG_LAB15_AUDIO_PCM_RING=y
CONFIG_LAB15_PEAK_ALLOC_ONLY=n
```

## client/labs/lab-16-attached-storage/main/Kconfig.projbuild
```kconfig
menu "LAB-16 attached storage smoke"

    config LAB16_BUILD_ID
        string "LAB-16 firmware build identity"
        default "lab16-fw-v2"

    config LAB16_BOOT_SETTLE_MS
        int "Delay after LAB16_READY before SD probe and mic capture (post-flash settle)"
        default 500
        range 0 5000

    config LAB16_STREAM_SECONDS
        int "Mic PCM stream duration (seconds)"
        default 210
        range 5 600

    config LAB16_PCM_START_LBA
        int "First sector for LAB16 PCM header (raw writes follow)"
        default 2048
        range 1 1000000

    config LAB16_WIFI_SSID
        string "Wi-Fi SSID for diary upload"
        default ""

    config LAB16_WIFI_PASSWORD
        string "Wi-Fi password"
        default ""

    config LAB16_SERVER_HOST
        string "h22-style diary server host"
        default "127.0.0.1"

    config LAB16_SERVER_PORT
        int "Diary server port"
        default 8776

    config LAB16_DEVICE_TOKEN
        string "Bearer token for /v1/diary"
        default "lab16-desk-token-v1"

    config LAB16_OVERLAP_RECORD_DURING_UPLOAD
        bool "Record a second message on SD while the first is still uploading"
        default n

    config LAB16_LIVE_STREAM_FAILOVER
        bool "Stream 1 s diary chunks during recording; buffer to SD on upload failure"
        default n

    config LAB16_CAPTURE_EVIDENCE
        bool "Capture same-boot memory and upload telemetry"
        default n

endmenu
```

## client/labs/lab-16-attached-storage/sdkconfig.defaults
```kconfig
CONFIG_IDF_TARGET="esp32s3"
CONFIG_ESPTOOLPY_FLASHSIZE_16MB=y
CONFIG_ESPTOOLPY_HEADER_FLASHSIZE_UPDATE=y
CONFIG_SPIRAM=y
CONFIG_SPIRAM_MODE_OCT=y
CONFIG_SPIRAM_SPEED_80M=y
CONFIG_SPIRAM_BOOT_INIT=y
CONFIG_SPIRAM_USE_MALLOC=y
CONFIG_ESP_CONSOLE_USB_SERIAL_JTAG=y
CONFIG_ESP_CONSOLE_SECONDARY_NONE=y
CONFIG_PARTITION_TABLE_CUSTOM=y
CONFIG_PARTITION_TABLE_CUSTOM_FILENAME="partitions.csv"
CONFIG_ESP_MAIN_TASK_STACK_SIZE=12288
CONFIG_LAB16_BUILD_ID="lab16-fw-v2"
CONFIG_LAB16_BOOT_SETTLE_MS=500
CONFIG_LAB16_STREAM_SECONDS=210
CONFIG_LAB16_PCM_START_LBA=2048
CONFIG_LAB16_SERVER_HOST="127.0.0.1"
CONFIG_LAB16_SERVER_PORT=8776
CONFIG_LAB16_DEVICE_TOKEN="lab16-desk-token-v1"
CONFIG_ESP_WIFI_ENABLED=y
```

## client/labs/lab-16-attached-storage/sdkconfig.defaults.livestream
```kconfig
CONFIG_LAB16_CAPTURE_EVIDENCE=y
CONFIG_LAB16_BUILD_ID="lab16-fw-v5-livestream-memory"
CONFIG_LAB16_STREAM_SECONDS=180
CONFIG_LAB16_LIVE_STREAM_FAILOVER=y
```

## client/labs/lab-16-attached-storage/sdkconfig.defaults.overlap
```kconfig
CONFIG_LAB16_CAPTURE_EVIDENCE=y
CONFIG_LAB16_BUILD_ID="lab16-fw-v5-overlap-memory"
CONFIG_LAB16_STREAM_SECONDS=180
CONFIG_LAB16_OVERLAP_RECORD_DURING_UPLOAD=y
```
